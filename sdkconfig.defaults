## sdkconfig.defaults
```kconfig
# 让 mbedTLS 使用智能分配器（小结构体走 DRAM，大 IO 缓冲走 PSRAM）
# 不要设 INTERNAL_MEM_ALLOC (全部 DRAM, 握手OOM) 也不要设 EXTERNAL_MEM_ALLOC (全部 PSRAM, DMA cache 损坏)
# 默认分配器 esp_mbedtls_mem_calloc 自动根据大小选择内存类型
# SSL 记录缓冲区 16KB（默认值，握手阶段用 VARIABLE_BUFFER 减到 8KB）
CONFIG_MBEDTLS_SSL_MAX_CONTENT_LEN=32768
# 关闭证书保留（节省 ~16KB 堆）
CONFIG_MBEDTLS_SSL_KEEP_PEER_CERTIFICATE=n
# 握手阶段只分配 8KB 记录缓冲，建连后自动扩到 16KB
CONFIG_MBEDTLS_SSL_VARIABLE_BUFFER_LENGTH=y
# ≤4KB 的分配强制走 DRAM（保障 mbedTLS 小结构体 + 硬件加密 DMA 所需）
CONFIG_SPIRAM_MALLOC_ALWAYSINTERNAL=4096
# ---- DRAM 保护：以下三项让 malloc/new/String 自动走 PSRAM，DRAM 留给 task 栈 ----
CONFIG_SPIRAM_USE_MALLOC=y
CONFIG_SPIRAM_TRY_ALLOCATE_WIFI_LWIP=y
# ---- 安全网 ----
CONFIG_ESP_TASK_WDT=y
CONFIG_ESP_TASK_WDT_TIMEOUT_S=30
CONFIG_FREERTOS_WATCHPOINT_END_OF_STACK=y
```
