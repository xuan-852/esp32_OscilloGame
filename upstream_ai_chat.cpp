/**
 * @file ai_chat.cpp
 * @brief AI 瀵硅瘽鍔熻兘锛堢ず娉㈠櫒缁堢鏄剧ず鐗堬級
 *
 * 娴佺▼锛氬綍闊筹紙INMP441 鈫?PSRAM锛夆啋 鐧惧害 ASR 鈫?DeepSeek 娴佸紡(SSE) 鈫?绀烘尝鍣ㄥ疄鏃堕€愬瓧鏄剧ず
 *
 * 寮曡剼锛歁IC_SCK=47, MIC_WS=48, MIC_DATA=1 (瀹氫箟鍦?pins.h)
 */

#include "ai_chat.h"
#include "ai_prompt.h"
#include "pins.h"
#include "microphone.h"
#include "freertos.h"
#include "web_server.h"
#include "vector_draw.h"
#include "DACoutput.h"
#include "voice_control.h"

#include <WiFi.h>
#include <WiFiClientSecure.h>
#include <HTTPClient.h>
#include <ArduinoJson.h>
#include "ai_config.h"
#include "network_manager.h"

#include <esp_heap_caps.h>   // heap_caps_get_free_size / MALLOC_CAP_DMA

#define SAMPLE_RATE      16000
#define MAX_RECORD_SEC   10      // 鏈€闀垮綍 10 绉掞紙鐢ㄦ埛鏉炬墜鍗冲仠锛屼笂闄愪繚鎶わ級
#define CHUNK_SIZE       512

volatile bool ai_chat_active = false;
volatile unsigned long ai_chat_activity_time = 0;

static char baidu_token[256] = {0};
static unsigned long token_expires = 0;

static bool     wifi_connect();
static bool     baidu_get_token();
static String   baidu_asr(const int16_t* pcm, size_t samples);
static bool     sse_process_line(const String& line, String& accumulated);
static String   deepseek_chat_stream(const String& text);
static void     ai_chat_task(void* pvParameters);

void AI_Chat_Start() {
    if (ai_chat_active) return;
    ai_chat_active = true;
    if (xTaskCreatePinnedToCore(ai_chat_task, "AIChatTask", 16384, NULL, 1, NULL, 0) != pdPASS) {
        ai_chat_active = false;
    }
}

// 闃舵寮忓叡浜樉绀?鈥?ai_chat_task(Core 0) 鍐欏叆, guiTask(Core 1) 娓叉煋
char  ai_chat_display_text[512];
volatile AIChatPhase ai_chat_phase = AI_PHASE_WAITING;
volatile bool ai_chat_dirty = false;

// 璁剧疆灞忓箷鏂囧瓧锛堢嚎绋嬪畨鍏細鍙啓涓€涓瓧娈?+ dirty 鏍囧織锛?static void ai_show(AIChatPhase phase, const char* text) {
    strncpy(ai_chat_display_text, text, sizeof(ai_chat_display_text) - 1);
    ai_chat_display_text[sizeof(ai_chat_display_text) - 1] = '\0';
    ai_chat_phase = phase;
    ai_chat_dirty = true;
    // 鍚屾鍒?Web 鐘舵€佺洃瑙嗗櫒
    updateWebUIStatus(String("[AI] ") + text);
}

// term_println 鍙緭鍑哄埌涓插彛锛屼笉鍐嶆樉绀哄湪灞忓箷涓?static void term_println(const char* msg) {
    USBSerial.println(msg);
}

static bool wifi_connect() {
    if (WiFi.status() == WL_CONNECTED) return true;
    USBSerial.println("Connecting WiFi...");
    WiFi.begin(WIFI_SSID, WIFI_PASSWORD);
    unsigned long t0 = millis();
    int tries = 0;
    while (WiFi.status() != WL_CONNECTED) {
        delay(500);
        USBSerial.print(".");
        if (++tries > 40) {
            USBSerial.println();
            term_println("ERROR: WiFi failed!");
            return false;
        }
    }
    USBSerial.printf("WiFi OK, IP: %s (%ums)\n", WiFi.localIP().toString().c_str(), millis() - t0);
    return true;
}

static bool baidu_get_token() {
    if (strlen(baidu_token) > 0 && millis() / 1000 < token_expires) return true;
    if (WiFi.status() != WL_CONNECTED) {
        USBSerial.println("WiFi lost! Reconnecting...");
        if (!wifi_connect()) return false;
    }

    for (int attempt = 0; attempt < 2; attempt++) {
        if (attempt > 0) { delay(2000); }

        WiFiClient client;
        HTTPClient http;
        String url = String("http://aip.baidubce.com/oauth/2.0/token")
                     + "?grant_type=client_credentials"
                     + "&client_id=" + BAIDU_API_KEY
                     + "&client_secret=" + BAIDU_SECRET_KEY;

        http.begin(client, url);
        http.setTimeout(10000);
        int code = http.GET();
        String resp = http.getString();
        http.end();

        if (code != 200) {
            USBSerial.printf("Baidu token fail: HTTP %d\n", code);
            continue;
        }

        JsonDocument doc;
        DeserializationError err = deserializeJson(doc, resp);
        if (err) { USBSerial.printf("Baidu token parse fail: %s\n", err.c_str()); continue; }

        const char* token = doc["access_token"];
        int expires_in = doc["expires_in"];
        if (!token) { USBSerial.println("Baidu token empty!"); continue; }

        strncpy(baidu_token, token, sizeof(baidu_token) - 1);
        token_expires = millis() / 1000 + expires_in - 86400;
        USBSerial.println("Baidu token OK");
        return true;
    }
    USBSerial.println("Baidu token exhausted retries");
    return false;
}

static String baidu_asr(const int16_t* pcm, size_t samples) {
    if (!baidu_get_token()) return String();
    size_t pcm_bytes = samples * sizeof(int16_t);
    if (pcm_bytes == 0) return String();

    WiFiClient client;
    HTTPClient http;
    String url = String("http://vop.baidu.com/server_api")
               + "?cuid=ESP32_S3"
               + "&token=" + baidu_token
               + "&dev_pid=1537";

    http.begin(client, url);
    http.addHeader("Content-Type", "audio/pcm;rate=16000");
    http.setTimeout(30000);

    int code = http.POST((uint8_t*)pcm, pcm_bytes);
    if (code != 200) {
        USBSerial.printf("ASR fail: HTTP %d\n", code);
        http.end();
        return String();
    }

    String resp = http.getString();
    http.end();

    JsonDocument doc;
    DeserializationError err = deserializeJson(doc, resp);
    if (err) { USBSerial.printf("ASR parse fail: %s\n", err.c_str()); return String(); }

    int err_no = doc["err_no"];
    if (err_no != 0) {
        const char* err_msg = doc["err_msg"];
        USBSerial.printf("ASR err: %s (%d)\n", err_msg ? err_msg : "", err_no);
        return String();
    }

    JsonArray result = doc["result"].as<JsonArray>();
    if (result.size() == 0) return String();
    return result[0].as<String>();
}

// 澶勭悊鍗曡 SSE data 浜嬩欢, 杩斿洖 true 琛ㄧず娴佺粨鏉?// accumulated: 澶栭儴浼犲叆鐨勭疮鍔犲瓧绗︿覆寮曠敤
// 瀹炴椂鏇存柊灞忓箷鏄剧ず
static bool sse_process_line(const String& line, String& accumulated) {
    if (!line.startsWith("data: ")) return false;
    String payload = line.substring(6);
    payload.trim();
    if (payload == "[DONE]") return true;

    JsonDocument doc;
    DeserializationError err = deserializeJson(doc, payload);
    if (err) return false;

    JsonArray choices = doc["choices"].as<JsonArray>();
    if (choices.size() == 0) return false;

    const char* finish = choices[0]["finish_reason"];
    const char* delta  = choices[0]["delta"]["content"];

    if (delta && strlen(delta) > 0) {
        accumulated += delta;
        USBSerial.print(delta);  // 涓插彛涔熷疄鏃惰緭鍑?        ai_show(AI_PHASE_REPLY, accumulated.c_str());
    }

    if (finish && strlen(finish) > 0) return true;
    return false;
}

static String deepseek_chat_stream(const String& text) {
    WiFiClientSecure client;
    client.setInsecure();
    client.setTimeout(15000);

    unsigned long t0 = millis();
    if (!client.connect("api.deepseek.com", 443)) {
        USBSerial.printf("DeepSeek: connect FAILED @ %ums\n", millis() - t0);
        return String();
    }
    client.setNoDelay(true);  // 杩炴帴鍚庢墠璁?TCP_NODELAY
    USBSerial.printf("DeepSeek: connected @ %ums\n", millis() - t0);

    // ---- 鏋勯€?JSON body (stream: true) ----
    JsonDocument req_doc;
    req_doc["model"] = "deepseek-chat";
    req_doc["temperature"] = 0.7;
    req_doc["max_tokens"] = 200;
    req_doc["stream"] = true; // 鈫?寮€鍚祦寮?
    JsonArray messages = req_doc["messages"].to<JsonArray>();
    JsonObject sys_msg = messages.add<JsonObject>();
    sys_msg["role"] = "system";
    sys_msg["content"] = AI_SYSTEM_PROMPT;

    JsonObject user_msg = messages.add<JsonObject>();
    user_msg["role"] = "user";
    user_msg["content"] = text;

    String body;
    serializeJson(req_doc, body);

    // ---- 鍙戦€佸師濮?HTTP 璇锋眰 ----
    String http_request =
        String("POST /chat/completions HTTP/1.1\r\n") +
        "Host: api.deepseek.com\r\n" +
        "Content-Type: application/json\r\n" +
        "Authorization: Bearer " + DEEPSEEK_API_KEY + "\r\n" +
        "Content-Length: " + body.length() + "\r\n" +
        "Accept: text/event-stream\r\n" +
        "Connection: close\r\n" +
        "\r\n" +
        body;

    size_t sent = client.print(http_request);
    USBSerial.printf("DeepSeek: sent %u/%u bytes\n", sent, http_request.length());
    if (sent < http_request.length()) {
        client.stop();
        USBSerial.println("DeepSeek: write failed, retrying...");
        return String();
    }

    // ---- 璇诲彇鍝嶅簲澶?----
    int http_code = 0;
    bool chunked = false;
    t0 = millis();

    while (client.connected() && millis() - t0 < 15000) {
        String line = client.readStringUntil('\n');
        line.trim();
        if (line.length() == 0) break;

        if (line.startsWith("HTTP/")) {
            int sp1 = line.indexOf(' ');
            int sp2 = line.indexOf(' ', sp1 + 1);
            http_code = line.substring(sp1 + 1, sp2).toInt();
        } else if (line.startsWith("Transfer-Encoding:") && line.indexOf("chunked") >= 0) {
            chunked = true;
        }
    }

    USBSerial.printf("DeepSeek: HTTP %d, chunked=%d (%ums)\n",
        http_code, chunked, millis() - t0);

    if (http_code != 200) {
        String err = client.readString();
        client.stop();
        USBSerial.printf("DeepSeek: error %d: %s\n", http_code, err.substring(0, 300).c_str());
        return String();
    }

    // ---- SSE 娴佸紡璇诲彇 & 瀹炴椂鏄剧ず ----
    String accumulated = "";
    t0 = millis();
    unsigned long last_data = t0;

    // 琛岀紦鍐插尯
    String line_buf;

    // 鎬昏秴鏃?30s, 鏁版嵁鍋滄粸瓒呮椂 8s
    const unsigned long TOTAL_TIMEOUT = 30000;
    const unsigned long STALL_TIMEOUT = 8000;

    if (chunked) {
        // chunked + SSE: 閫愯璇诲彇 chunk 鍐呭
        while (client.connected() && millis() - t0 < TOTAL_TIMEOUT) {
            // 璇?chunk size 琛?            String hex_line = client.readStringUntil('\n');
            hex_line.trim();
            if (hex_line.length() == 0) continue;
            long chunk_size = strtol(hex_line.c_str(), NULL, 16);
            if (chunk_size <= 0) break;

            // 閫愬瓧鑺傝 chunk data, 鎷煎嚭琛? 澶勭悊 SSE
            long remain = chunk_size;
            while (remain > 0 && millis() - t0 < TOTAL_TIMEOUT) {
                if (millis() - last_data > STALL_TIMEOUT) {
                    USBSerial.println("\nDeepSeek: SSE stall timeout");
                    goto sse_done;
                }
                if (client.available()) {
                    char c = client.read();
                    remain--;
                    last_data = millis();

                    if (c == '\n') {
                        // 涓€琛岀粨鏉? 澶勭悊 SSE
                        line_buf.trim();
                        if (sse_process_line(line_buf, accumulated)) {
                            client.readStringUntil('\n'); // 璺宠繃 chunk 灏?\r\n
                            goto sse_done;
                        }
                        line_buf = "";
                    } else if (c != '\r') {
                        line_buf += c;
                    }
                } else {
                    if (!client.connected()) break;
                    delay(1);
                }
            }
            client.readStringUntil('\n'); // 璺宠繃 chunk 灏鹃儴 \r\n
        }
    } else {
        // 闈?chunked (fallback): 閫愬瓧鑺傝鍒拌繛鎺ュ叧闂?        while (client.connected() && millis() - t0 < TOTAL_TIMEOUT) {
            if (millis() - last_data > STALL_TIMEOUT) break;
            if (client.available()) {
                char c = client.read();
                last_data = millis();
                if (c == '\n') {
                    line_buf.trim();
                    if (sse_process_line(line_buf, accumulated)) { break; }
                    line_buf = "";
                } else if (c != '\r') {
                    line_buf += c;
                }
            } else { delay(1); }
        }
        // 璇绘畫浣?        while (client.available()) {
            char c = client.read();
            if (c == '\n') {
                line_buf.trim();
                if (sse_process_line(line_buf, accumulated)) break;
                line_buf = "";
            } else if (c != '\r') {
                line_buf += c;
            }
        }
    }

sse_done:
    client.stop();
    USBSerial.printf("\nDeepSeek: SSE done, %u chars, %ums\n",
        accumulated.length(), millis() - t0);

    if (accumulated.length() == 0) {
        USBSerial.println("DeepSeek: empty stream");
        return String();
    }

    USBSerial.println("\n=== DeepSeek RAW ===");
    USBSerial.println(accumulated);
    USBSerial.println("=== END RAW ===\n");

    return accumulated;
}

static void ai_chat_task(void* pvParameters) {
    ai_chat_active = true;
    ai_chat_activity_time = millis();

    String recognized, reply;
    int16_t* pcm_buffer = nullptr;
    size_t total_samples = 0;
    size_t max_samples = SAMPLE_RATE * MAX_RECORD_SEC;
    size_t alloc_bytes = 0;
    int16_t chunk_buf[CHUNK_SIZE];
    int high_cnt = 0;
    uint8_t saved_step = DRAW_GetStepSize();
    bool has_action = false;
    bool first_wait = true;
    Microphone* mic = nullptr;

    DRAW_SetStepSize(16);

    // ---- 鏆傚仠闈炲繀瑕佷换鍔★紝鍑忓皯鍫嗙鐗囩粰 SSL ----
    suspendNonessentialTasks();

    // ---- WiFi ----
    if (!wifi_connect()) { goto done; }

    // ---- 鍏抽棴 ESP-NOW锛堥伩鍏?WiFi 鍐茬獊锛?----
    Network_Manager::suspend_esp_now();

    // ---- 鑾峰彇 Baidu token ----
    USBSerial.println("Getting Baidu token...");
    if (!baidu_get_token()) {
        term_println("ERROR: Baidu token FAILED!");
        goto done;
    }

    // ---- 鍒嗛厤 PSRAM 褰曢煶缂撳啿鍖?----
    alloc_bytes = max_samples * sizeof(int16_t);
    pcm_buffer = (int16_t*)ps_malloc(alloc_bytes);
    if (!pcm_buffer) {
        term_println("ERROR: PSRAM alloc failed!");
        goto done;
    }
    USBSerial.printf("PSRAM buffer: %u bytes\n", alloc_bytes);

    // ---- 澶氳疆瀵硅瘽寰幆 ----
    // MIC 涓嶅湪姝ゅ垵濮嬪寲锛屾瘡杞寜闇€鍒涘缓锛堝綍闊冲墠鍒涘缓锛孌eepSeek 鍓嶉噴鏀?I2S DMA锛?    while (ai_chat_active) {
        // 浠呯涓€杞瓑寰呮椂鏄剧ず鎻愮ず锛堝洖澶嶅悗鎻愮ず浼氳鐩栧唴瀹癸級
        if (first_wait) {
            ai_show(AI_PHASE_WAITING, "Long press=record, short=exit");
            ai_chat_activity_time = millis();
            USBSerial.println("Waiting: long press=record, short=exit");
        }
        first_wait = false;

        // ---- 绛夊緟鎸夐敭 ----
        while (digitalRead(EN_S) == HIGH) {
            if (!ai_chat_active) goto done;
            vTaskDelay(pdMS_TO_TICKS(20));
        }

        // ---- 鐭寜 vs 闀挎寜妫€娴?----
        unsigned long press_ms = millis();
        bool short_press = true;

        while (digitalRead(EN_S) == LOW) {
            if (!ai_chat_active) goto done;
            if (millis() - press_ms >= 300) {
                short_press = false;     // 瓒呰繃300ms = 闀挎寜
                break;
            }
            vTaskDelay(pdMS_TO_TICKS(5));
        }

        if (short_press) {
            USBSerial.println("Short press 鈫?exit");
            break;  // 鐭寜閫€鍑?        }

        // ---- 闀挎寜 鈫?褰曢煶锛堟寜浣忔寔缁綍锛屾澗鎵嬪仠姝級----
        // 鍏堥噴鏀?BLE DMA锛堝鏈夛級锛岃鍫嗗悎骞舵垚澶у潡锛涘啀鍒涘缓 MIC锛岄伩鍏嶇鐗?        deinitHardwareDMA();
        if (!mic) {
            mic = new Microphone(MIC_SCK, MIC_WS, MIC_DATA, SAMPLE_RATE);
            if (!mic || !mic->init()) {
                term_println("ERROR: MIC re-init FAILED!");
                delete mic;
                mic = nullptr;
                continue;
            }
        }

        USBSerial.println("Recording... release to stop");
        ai_show(AI_PHASE_THINKING, "Recording...");

        total_samples = 0;
        high_cnt = 0;

        while (total_samples < max_samples) {
            if (!ai_chat_active) goto done;
            if (digitalRead(EN_S) == HIGH) {
                high_cnt++;
                if (high_cnt > 15 && total_samples > SAMPLE_RATE / 4) break;
            } else {
                high_cnt = 0;
            }
            size_t n = mic->read(chunk_buf, CHUNK_SIZE);
            if (n == 0) break;
            memcpy(pcm_buffer + total_samples, chunk_buf, n * sizeof(int16_t));
            total_samples += n;
            vTaskDelay(pdMS_TO_TICKS(1));
        }

        if (total_samples < SAMPLE_RATE / 4) {
            term_println("ERROR: Too short!");
            continue;
        }
        USBSerial.printf("Recorded: %.1fs (%zu samples)\n",
                         (float)total_samples / SAMPLE_RATE, total_samples);

        // ---- 閲婃斁 MIC (I2S DMA)锛岀粰鍚庣画 SSL 鑵惧嚭 DMA 鍐呭瓨 ----
        if (mic) { delete mic; mic = nullptr; }

        // ---- ASR ----
        USBSerial.println("Recognizing...");
        ai_show(AI_PHASE_THINKING, "Thinking...");
        recognized = baidu_asr(pcm_buffer, total_samples);
        if (recognized.length() == 0) {
            term_println("ERROR: ASR failed");
            continue;
        }
        USBSerial.printf("You: %s\n", recognized.c_str());

        // ---- DeepSeek (娴佸紡 SSE锛屽け璐ヨ嚜鍔ㄩ噸璇?1 娆? ----
        ai_show(AI_PHASE_REPLY, "Asking DeepSeek...");
        {
            // 璋冭瘯锛氭煡鐪嬪唴閮?SRAM 鍙敤閲?            size_t dma_free = heap_caps_get_free_size(MALLOC_CAP_DMA);
            size_t dma_largest = heap_caps_get_largest_free_block(MALLOC_CAP_DMA);
            size_t heap_free = heap_caps_get_free_size(MALLOC_CAP_DEFAULT);
            USBSerial.printf("Heap: DMA free=%u (largest=%u), DEFAULT free=%u\n",
                dma_free, dma_largest, heap_free);
        }
        for (int retry = 0;; retry++) {
            reply = deepseek_chat_stream(recognized);
            if (reply.length() > 0) break;          // 鎴愬姛
            if (retry >= 1) break;                   // 閲嶈瘯 1 娆¤繕澶辫触 鈫?鏀惧純
            USBSerial.println("DeepSeek: retrying after 1s...");
            ai_show(AI_PHASE_REPLY, "Retrying...");
            vTaskDelay(pdMS_TO_TICKS(1000));
        }

        if (reply.length() == 0) {
            term_println("ERROR: DeepSeek failed");
            voice_action = VC_NONE;
            has_action = false;
            ai_show(AI_PHASE_REPLY, "DeepSeek timed out");
            vTaskDelay(pdMS_TO_TICKS(1500));
            continue;
        }

        // ---- 瑙ｆ瀽 JSON action ----
        {
            String parsed = VC_ParseReply(reply);
            has_action = (voice_action != VC_NONE);
            if (parsed.length() > 0) {
                ai_show(AI_PHASE_REPLY, parsed.c_str());
            }
        }

        // ---- 鏈夊姩浣滄椂閫€鍑猴紙guiTask 鎵ц锛?---
        if (has_action) {
            USBSerial.println("[Executing action...]");
            vTaskDelay(pdMS_TO_TICKS(500));
            break;
        }

        // ---- 鍥炲淇濇寔鍙锛岀瓑寰呬笅涓€杞緭鍏?----
        // 涓嶆樉绀?"Long press=record, short=exit"锛堥伩鍏嶈鐩栧洖澶嶆枃鏈級
        // 鐩存帴鍥炲埌鎸夐敭绛夊緟锛岀敤鎴风煭鎸夐€€鍑烘垨闀挎寜缁х画褰曢煶
        USBSerial.println("Press ENTER: short=exit, long=record again");
        ai_chat_activity_time = millis();
        // 鐭殏鍋滈】鍚庣户缁紙涓嶈鐩栧睆骞曪紝鍥炲鍐呭淇濇寔鏄剧ず锛?        vTaskDelay(pdMS_TO_TICKS(300));
    }

done:
    reinitHardwareDMA();  // BLE 鍚庣画鐢?joystickCheckTask 鑷姩鎭㈠
    Network_Manager::resume_esp_now();
    resumeNonessentialTasks();
    if (mic) { delete mic; mic = nullptr; }
    ai_chat_dirty = true;
    if (pcm_buffer) free(pcm_buffer);
    DRAW_SetStepSize(saved_step);
    ai_chat_active = false;
    vTaskDelete(NULL);
}

